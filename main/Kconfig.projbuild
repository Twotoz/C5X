## main/Kconfig.projbuild
```kconfig
menu "C5X R0"

config C5X_CAPTURE_BYTES
    int "Bounded Q4/I4 capture size"
    range 4096 65536
    default 16384
    help
        Bytes captured from MODEM_DIAG through PARLIO for each R0 record.
        At 40 MS/s, 16384 bytes corresponds to about 409.6 us.

config C5X_TX_BURST_FRAMES
    int "Raw 802.11 frames per overlap burst"
    range 1 32
    default 8

config C5X_TX_MAX_POWER_QDBM
    int "Maximum Wi-Fi TX power, quarter-dBm units"
    range 8 40
    default 8
    help
        Kept deliberately low for the first self-interference experiments.
        8 corresponds to a nominal 2 dBm request.

endmenu
```

## sdkconfig.defaults
```kconfig
CONFIG_IDF_TARGET="esp32c5"

# CPU / flash
CONFIG_ESP_DEFAULT_CPU_FREQ_MHZ_240=y
CONFIG_ESPTOOLPY_FLASHSIZE_8MB=y
CONFIG_ESPTOOLPY_FLASHMODE_QIO=y
CONFIG_ESPTOOLPY_FLASHFREQ_80M=y

# Partition table
CONFIG_PARTITION_TABLE_CUSTOM=y
CONFIG_PARTITION_TABLE_CUSTOM_FILENAME="partitions.csv"

# Console
CONFIG_ESP_CONSOLE_USB_SERIAL_JTAG=y

# FreeRTOS / logging
CONFIG_FREERTOS_HZ=1000
CONFIG_LOG_DEFAULT_LEVEL_INFO=y

# Wi-Fi / PHY
CONFIG_ESP_WIFI_STATIC_RX_BUFFER_NUM=4
CONFIG_ESP_WIFI_DYNAMIC_RX_BUFFER_NUM=8
CONFIG_ESP_WIFI_TX_BUFFER_TYPE_DYNAMIC=y
CONFIG_ESP_WIFI_STA_DISCONNECTED_PM_ENABLE=n
CONFIG_ESP_PHY_ENABLE_CERT_TEST=y
CONFIG_ESP_PHY_DEBUG=y
CONFIG_ESP_PHY_DISABLE_PLL_TRACK=y

# Keep the first RF experiments deterministic.
CONFIG_PM_ENABLE=n
CONFIG_IEEE802154_ENABLED=n
CONFIG_ESP_COEX_SW_COEXIST_ENABLE=n
```
